/*
MIT License
Copyright (c) 2023 lovyan03
Permission is hereby granted, free of charge, to any person obtaining a copy
of this software and associated documentation files (the "Software"), to deal
in the Software without restriction, including without limitation the rights
to use, copy, modify, merge, publish, distribute, sublicense, and/or sell
copies of the Software, and to permit persons to whom the Software is
furnished to do so, subject to the following conditions:
The above copyright notice and this permission notice shall be included in all
copies or substantial portions of the Software.
THE SOFTWARE IS PROVIDED "AS IS", WITHOUT WARRANTY OF ANY KIND, EXPRESS OR
IMPLIED, INCLUDING BUT NOT LIMITED TO THE WARRANTIES OF MERCHANTABILITY,
FITNESS FOR A PARTICULAR PURPOSE AND NONINFRINGEMENT. IN NO EVENT SHALL THE
AUTHORS OR COPYRIGHT HOLDERS BE LIABLE FOR ANY CLAIM, DAMAGES OR OTHER
LIABILITY, WHETHER IN AN ACTION OF CONTRACT, TORT OR OTHERWISE, ARISING FROM,
OUT OF OR IN CONNECTION WITH THE SOFTWARE OR THE USE OR OTHER DEALINGS IN THE
SOFTWARE.
*/
// フレームワークは earlephilhower版のArduinoCoreを使用。
// ※ mbed公式版では動作しない
/*
  The code in this file is modified by KenKen.
*/

#pragma GCC optimize ("O2")

#include <Arduino.h>
#include <stdio.h>
#include <stdint.h>
#include <math.h>
#include <string.h>

#include <pico/stdlib.h>
#include <hardware/dma.h>
#include <hardware/pwm.h>
#include <hardware/clocks.h>

// NTSC信号をPWM出力するピン
#define PIN_OUTPUT 19

// デバッグ用、割込み処理中HIGHになるピン
//#define PIN_DEBUG_BUSY 15

#define FRAME_WIDTH 336
#define FRAME_HEIGHT 216
#define WIDTH_X 42
#define WIDTH_Y 27
#define ATTROFFSET (WIDTH_X*WIDTH_Y)
uint8_t TVRAM[ATTROFFSET*2+1];
uint8_t framebuffer[FRAME_WIDTH * FRAME_HEIGHT] __attribute__ ((aligned (4)));
uint8_t *cursor;
uint8_t cursorcolor;
volatile uint16_t drawcount=0;
#define X_RES FRAME_WIDTH
#define Y_RES FRAME_HEIGHT
#define GVRAM framebuffer

// NTSC出力 1ラインあたりのサンプル数
#define NUM_LINE_SAMPLES 908  // 227 * 4

// NTSC出力 走査線数
#define NUM_LINES 262  // 走査線262本

#define V_SYNC		10	// 垂直同期本数
#define V_PREEQ		26	// ブランキング区間上側
#define H_SYNC		68	// 水平同期幅、約4.7μsec
#define H_PICTURE (H_SYNC+8+9*4+60) // 映像開始位置

extern const unsigned char FontData[];

// DMAピンポンバッファ
uint16_t dma_buffer[2][(NUM_LINE_SAMPLES+3)&~3u] __attribute__ ((aligned (4)));

// カラーパレット
uint16_t color_tbl[4*256] __attribute__ ((aligned (4)));

static int pwm_dma_chan;

static void makeDmaBuffer(uint16_t* buf, size_t line_num)
{
  static uint8_t* fbp = framebuffer;
  static uint8_t* tvp = TVRAM;
  static uint8_t tline = 0;
  uint16_t* b = buf;

  if (line_num < 2)
  {
    for (int j = 0; j < NUM_LINE_SAMPLES-H_SYNC; j++) *b++ = 0;
    while (b < buf + NUM_LINE_SAMPLES) *b++ = 2;
  }
  else if(line_num==V_SYNC || line_num==V_SYNC+1)
  {
    for (int j = 0; j < H_SYNC; j++) *b++ = 0;
    for (int j = 0; j < 8; j++) *b++ = 2;
    for (int j = 0; j < 9; j++)
    {
      *b++=1;
      *b++=2;
      *b++=3;
      *b++=2;
    }
    while (b < buf + NUM_LINE_SAMPLES) *b++ = 2;
  }
  else if(line_num>=V_SYNC+V_PREEQ && line_num<V_SYNC+V_PREEQ+FRAME_HEIGHT)
  {
    b+=H_PICTURE;
    if (line_num == V_SYNC + V_PREEQ)
    {
      fbp = framebuffer;
      tvp = TVRAM;
      tline = 0;
    }
    for(int i=0;i<WIDTH_X;i++)
    {
      uint8_t d=FontData[*tvp *8 +tline];
      uint16_t* clp=color_tbl+(*(tvp+ATTROFFSET))*4;
      uint32_t c1=*((uint32_t*)clp);
      uint32_t c2=*((uint32_t*)(clp+2));
      for(int j=0;j<4;j++)
      {
        uint16_t t=*(uint16_t*)fbp;
        if(d & 0x80){
          *((uint32_t*)b)=c1;
        }
        else{
          *((uint32_t*)b)=*((uint32_t*)(color_tbl+(t & 0xff)*4));
        }
        b+=2;
        if(d & 0x40){
          *((uint32_t*)b)=c2;
        }
        else{
          *((uint32_t*)b)=*((uint32_t*)(color_tbl+(t >> 8)*4+2));
        }
        b+=2;
        fbp+=2;
        d<<=2;
      }
      tvp++;
    }
    tline++;
    if(tline<8) tvp-=WIDTH_X;
    else tline=0;
  }
  else if(line_num==V_SYNC+V_PREEQ+FRAME_HEIGHT || line_num==V_SYNC+V_PREEQ+FRAME_HEIGHT+1)
  {
    b+=H_PICTURE;
    for(int i=0;i<FRAME_WIDTH*2;i++) *b++ = 2;
  }
}

static void setup_palette_ntsc_inner(uint32_t rgb, uint8_t c, uint32_t diff_level, uint32_t base_level, float satuation_base, float chroma_scale)
{
  static constexpr float BASE_RAD = (M_PI * 140) / 180;

  uint32_t r = rgb >> 16;
  uint32_t g = (rgb >> 8) & 0xFF;
  uint32_t b = rgb & 0xFF;

  float y = r * 0.299f + g * 0.587f + b * 0.114f;
  float i = (b - y) * -0.2680f + (r - y) * 0.7358f;
  float q = (b - y) *  0.4127f + (r - y) * 0.4778f;
  y = y * diff_level / 256 + base_level;

  float phase_offset = atan2f(i, q) + BASE_RAD;
  float saturation = sqrtf(i * i + q * q) * chroma_scale;
  saturation = saturation * satuation_base;
  for (int j = 0; j < 4; j++)
  {
    int tmp = ((int)(128.5f + y + sinf(phase_offset + (float)M_PI / 2 * j) * saturation)) >> 8;
    color_tbl[c*4+j] = tmp < 0 ? 0 : (tmp > 255 ? 255 : tmp);
  }
}

static void setup_palette_ntsc(uint_fast16_t white_level, uint_fast16_t black_level, uint_fast8_t chroma_level)
{
  float chroma_scale = chroma_level / 7168.0f;
  float satuation_base = black_level / 2;
  uint32_t diff_level = white_level - black_level;

  for (int i = 0; i < 8; i++)
  {
    int r = 255*((i>>1)&1);
    int g = 255*(i>>2);
    int b = 255*(i&1);
    setup_palette_ntsc_inner(r<<16|g<<8|b, i, diff_level, black_level, satuation_base, chroma_scale);
  }
  for (int i = 0; i < 8; i++)
  {
    int r = 128*((i>>1)&1);
    int g = 128*(i>>2);
    int b = 128*(i&1);
    setup_palette_ntsc_inner(r<<16|g<<8|b, i+8, diff_level, black_level, satuation_base, chroma_scale);
  }
  for (int i = 16; i < 255; i++)
  {
    setup_palette_ntsc_inner(0, i, diff_level, black_level, satuation_base, chroma_scale);
  }
}

static void irq_handler(void) {
  static bool flip = false;
  static size_t scanline = 0;
  dma_channel_set_read_addr(pwm_dma_chan, dma_buffer[flip], true);
  dma_hw->ints0 = 1u << pwm_dma_chan;	

#if defined ( PIN_DEBUG_BUSY )
  digitalWrite(PIN_DEBUG_BUSY, HIGH);
#endif
  flip = !flip;
  makeDmaBuffer(dma_buffer[flip], scanline);
  if (++scanline >= NUM_LINES) {
    scanline = 0;
    drawcount++;
  }
#if defined ( PIN_DEBUG_BUSY )
  digitalWrite(PIN_DEBUG_BUSY, LOW);
#endif
}

// ------------------------
// Graphic and Text Library
// ------------------------
void g_pset(int x, int y, int c)
{
  if((unsigned int)x>=FRAME_WIDTH) return;
  if((unsigned int)y>=FRAME_HEIGHT) return;
  framebuffer[y*FRAME_WIDTH+x]=c;
}
void g_gline(int x1,int y1,int x2,int y2,unsigned char c)
// (x1,y1)-(x2,y2)にカラーパレット番号cで線分を描画
{
	int sx,sy,dx,dy,i;
	int e;

	if(x2>x1){
		dx=x2-x1;
		sx=1;
	}
	else{
		dx=x1-x2;
		sx=-1;
	}
	if(y2>y1){
		dy=y2-y1;
		sy=1;
	}
	else{
		dy=y1-y2;
		sy=-1;
	}
	if(dx>=dy){
		e=-dx;
		for(i=0;i<=dx;i++){
			g_pset(x1,y1,c);
			x1+=sx;
			e+=dy*2;
			if(e>=0){
				y1+=sy;
				e-=dx*2;
			}
		}
	}
	else{
		e=-dy;
		for(i=0;i<=dy;i++){
			g_pset(x1,y1,c);
			y1+=sy;
			e+=dx*2;
			if(e>=0){
				x1+=sx;
				e-=dy*2;
			}
		}
	}
}
void g_hline(int x1,int x2,int y,unsigned char c)
// (x1,y)-(x2,y)への水平ラインを高速描画
{
	int temp;
	unsigned int d,*ad;

	if(y<0 || y>=Y_RES) return;
	if(x1>x2){
		temp=x1;
		x1=x2;
		x2=temp;
	}
	if(x2<0 || x1>=X_RES) return;
	if(x1<0) x1=0;
	if(x2>=X_RES) x2=X_RES-1;
  uint8_t* p1=framebuffer+y*X_RES+x1;
  uint8_t* p2=p1-x1+x2;
  while(x1&3){
    g_pset(x1++,y,c);
    if(x1>x2) return;
  }
  d=c|(c<<8)|(c<<16)|(c<<24);
  ad=(unsigned int *)(GVRAM+y*X_RES+x1);
  while(x1+3<=x2){
    *ad++=d;
    x1+=4;
  }
  while(x1<=x2) g_pset(x1++,y,c);
}

void g_circle(int x0,int y0,unsigned int r,unsigned char c)
// (x0,y0)を中心に、半径r、カラーパレット番号cの円を描画
{
	int x,y,f;
	x=r;
	y=0;
	f=-2*r+3;
	while(x>=y){
		g_pset(x0-x,y0-y,c);
		g_pset(x0-x,y0+y,c);
		g_pset(x0+x,y0-y,c);
		g_pset(x0+x,y0+y,c);
		g_pset(x0-y,y0-x,c);
		g_pset(x0-y,y0+x,c);
		g_pset(x0+y,y0-x,c);
		g_pset(x0+y,y0+x,c);
		if(f>=0){
			x--;
			f-=x*4;
		}
		y++;
		f+=y*4+2;
	}
}
void g_boxfill(int x1,int y1,int x2,int y2,unsigned char c)
// (x1,y1),(x2,y2)を対角線とするカラーパレット番号cで塗られた長方形を描画
{
	int temp;
	if(x1>x2){
		temp=x1;
		x1=x2;
		x2=temp;
	}
	if(x2<0 || x1>=X_RES) return;
	if(y1>y2){
		temp=y1;
		y1=y2;
		y2=temp;
	}
	if(y2<0 || y1>=Y_RES) return;
	if(y1<0) y1=0;
	if(y2>=Y_RES) y2=Y_RES-1;
	while(y1<=y2){
		g_hline(x1,x2,y1++,c);
	}
}
void g_circlefill(int x0,int y0,unsigned int r,unsigned char c)
// (x0,y0)を中心に、半径r、カラーパレット番号cで塗られた円を描画
{
	int x,y,f;
	x=r;
	y=0;
	f=-2*r+3;
	while(x>=y){
		g_hline(x0-x,x0+x,y0-y,c);
		g_hline(x0-x,x0+x,y0+y,c);
		g_hline(x0-y,x0+y,y0-x,c);
		g_hline(x0-y,x0+y,y0+x,c);
		if(f>=0){
			x--;
			f-=x*4;
		}
		y++;
		f+=y*4+2;
	}
}
void g_cls(void)
{
  uint32_t* p=(uint32_t*)framebuffer;
  for(int i=0;i<FRAME_WIDTH*FRAME_HEIGHT/4;i++) *p++=0;
}
void t_cls(void)
{
  uint32_t* p=(uint32_t*)TVRAM;
  for(int i=0;i<WIDTH_X*WIDTH_Y*2/4;i++) *p++=0;
	cursor=TVRAM;
}
void vramscroll(void){
	unsigned char *p1,*p2,*vramend;

	vramend=TVRAM+WIDTH_X*WIDTH_Y;
	p1=TVRAM;
	p2=p1+WIDTH_X;
	while(p2<vramend){
		*(p1+ATTROFFSET)=*(p2+ATTROFFSET);
		*p1++=*p2++;
	}
	while(p1<vramend){
		*(p1+ATTROFFSET)=0;
		*p1++=0;
	}
}
void setcursor(unsigned char x,unsigned char y,unsigned char c){
	//カーソルを座標(x,y)にカラー番号cに設定
	if(x>=WIDTH_X || y>=WIDTH_Y) return;
	cursor=TVRAM+y*WIDTH_X+x;
	cursorcolor=c;
}
void setcursorcolor(unsigned char c){
	//カーソル位置そのままでカラー番号をcに設定
	cursorcolor=c;
}
void printchar(unsigned char n){
	//カーソル位置にテキストコードnを1文字表示し、カーソルを1文字進める
	//画面最終文字表示してもスクロールせず、次の文字表示時にスクロールする
	if(cursor<TVRAM || cursor>TVRAM+WIDTH_X*WIDTH_Y) return;
	if(cursor==TVRAM+WIDTH_X*WIDTH_Y){
		vramscroll();
		cursor-=WIDTH_X;
	}
	if(n=='\n'){
		//改行
		cursor+=WIDTH_X-((cursor-TVRAM)%WIDTH_X);
	} else if(n==0x08){
		//BS
		if (TVRAM<cursor) cursor--;
	} else{
		*cursor=n;
		*(cursor+ATTROFFSET)=cursorcolor;
		cursor++;
	}
}
void printstr(unsigned char *s){
	//カーソル位置に文字列sを表示
	while(*s){
		printchar(*s++);
	}
}
void printnum(unsigned int n){
	//カーソル位置に符号なし整数nを10進数表示
	unsigned int d,n1;
	n1=n/10;
	d=1;
	while(n1>=d){
		d*=10;
	}
	while(d!=0){
		printchar('0'+n/d);
		n%=d;
		d/=10;
	}
}
void printnum2(unsigned int n,unsigned char e){
	//カーソル位置に符号なし整数nをe桁の10進数表示（前の空き桁部分はスペースで埋める）
	unsigned int d,n1;
	if(e==0) return;
	n1=n/10;
	d=1;
	e--;
	while(e>0 && n1>=d){
		d*=10;
		e--;
	}
	if(e==0 && n1>d) n%=d*10;
	for(;e>0;e--) printchar(' ');
	while(d!=0){
		printchar('0'+n/d);
		n%=d;
		d/=10;
	}
}

void setup(void)
{
#if defined ( PIN_DEBUG_BUSY )
  pinMode(PIN_DEBUG_BUSY, OUTPUT);
#endif
//  setup_palette_ntsc(960*2, 286*2, 128);
  setup_palette_ntsc(1200*2, 286*2, 128);
  g_cls();
  t_cls();

  // CPUを157.5MHzで動作させる
  uint32_t freq_khz = 157500;

  // PWM周期を11サイクルとする (157.5 [MHz] / 11 = 14318181 [Hz])
  uint32_t pwm_div = 11;

  // ※ NTSCのカラー信号を1周期4サンプルで出力する。
  // 出力されるカラーバースト信号は  14318181 [Hz] / 4 = 3579545 [Hz] となる。

  set_sys_clock_khz(freq_khz, true);

  gpio_set_function(PIN_OUTPUT, GPIO_FUNC_PWM);
  auto pwm_slice_num = pwm_gpio_to_slice_num(PIN_OUTPUT);

  pwm_config config = pwm_get_default_config();
  pwm_config_set_clkdiv(&config, 1);

  pwm_init(pwm_slice_num, &config, true);
  pwm_set_wrap(pwm_slice_num, pwm_div - 1);

  pwm_dma_chan = dma_claim_unused_channel(true);
  auto pwm_dma_chan_config = dma_channel_get_default_config(pwm_dma_chan);
  channel_config_set_transfer_data_size(&pwm_dma_chan_config, DMA_SIZE_16);
  channel_config_set_read_increment(&pwm_dma_chan_config, true);
  channel_config_set_write_increment(&pwm_dma_chan_config, false);
  channel_config_set_dreq(&pwm_dma_chan_config, DREQ_PWM_WRAP0 + pwm_slice_num);

  volatile void* wr_addr = &pwm_hw->slice[pwm_slice_num].cc;
  wr_addr = (volatile void*)(((uintptr_t)wr_addr) + 2);

  makeDmaBuffer(dma_buffer[0], 0);

  dma_channel_configure(
      pwm_dma_chan,
      &pwm_dma_chan_config,
      wr_addr,
      dma_buffer[0],
      NUM_LINE_SAMPLES,
      true
  );
  dma_channel_set_irq0_enabled(pwm_dma_chan, true);
  irq_set_exclusive_handler(DMA_IRQ_0, irq_handler);
  irq_set_enabled(DMA_IRQ_0, true);
}

//
// Demo Program
//
#include <stdlib.h>
void loop(void)
{
  static int counter=0;
  static uint8_t ch=0x21;
  drawcount=0;
  counter++;
  if(counter<100){
    if(counter==1){
      g_cls();
      t_cls();
      for(int c=0;c<8;c++){
        g_boxfill(c*42, 0, c*42+41, FRAME_HEIGHT/2-1, 7-c);
        g_boxfill(c*42, FRAME_HEIGHT/2, c*42+41, FRAME_HEIGHT-1, 15-c);
      }
    }
  }
  else if(counter<200){
    if(counter==100){
      g_cls();
      t_cls();
    }
    setcursor(0, 0, 7);
    printnum(counter);
    g_gline((rand()&255), (rand()&255), (rand()&255)+100, (rand()&255), (rand()&15)+1);
  }
  else if(counter<300){
    if(counter==200){
      g_cls();
      t_cls();
    }
    setcursor(0, 0, 7);
    printnum(counter-200+1);
    g_circlefill((rand()&255)+50, (rand()&127)+50, (rand()&63)+20, (rand()&15)+1);
  }
  else if(counter<600){
    if(counter==300){
      printchar('\n');
    }
    if((counter&3)==0){
      for(int i=0;i<WIDTH_X;i++){
        setcursorcolor(rand()&7);
        printchar(ch++);
        if(ch>0xf7) ch=0x21;
      }
    }
  }
  else counter=0;
  while(drawcount<1) asm("wfi");
}

const unsigned char FontData[256*8]={
//フォントデータ、キャラクタコード順に8バイトずつ、上位ビットが左
	0x00,0x00,0x00,0x00,0x00,0x00,0x00,0x00,
	0x00,0x00,0x00,0x00,0x00,0x00,0x00,0x00,
	0x00,0x00,0x00,0x00,0x00,0x00,0x00,0x00,
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	0x00,0x00,0x00,0x00,0x00,0x00,0x00,0x00
};